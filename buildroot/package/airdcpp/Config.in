## buildroot/package/airdcpp/Config.in
```kconfig
comment "airdcpp needs a glibc toolchain w/ C++, threads, wchar, gcc >= 4.8, host gcc >= 4.8"
	depends on !BR2_INSTALL_LIBSTDCPP || !BR2_TOOLCHAIN_HAS_THREADS \
		|| !BR2_USE_WCHAR \
		|| !BR2_HOST_GCC_AT_LEAST_4_8 \
		|| !BR2_TOOLCHAIN_GCC_AT_LEAST_4_8

menuconfig BR2_PACKAGE_AIRDCPP
	bool "airdcpp"
	depends on BR2_INSTALL_LIBSTDCPP
	depends on BR2_HOST_GCC_AT_LEAST_4_8
	depends on BR2_TOOLCHAIN_GCC_AT_LEAST_4_8
	depends on BR2_TOOLCHAIN_HAS_THREADS
	depends on BR2_USE_WCHAR
	select BR2_PACKAGE_BOOST
	select BR2_PACKAGE_BOOST_REGEX
	select BR2_PACKAGE_BOOST_SYSTEM
	select BR2_PACKAGE_BOOST_THREAD
	select BR2_PACKAGE_BZIP2
	select BR2_PACKAGE_GEOIP
	select BR2_PACKAGE_LEVELDB
	select BR2_PACKAGE_LIBMINIUPNPC
	select BR2_PACKAGE_OPENSSL
	select BR2_PACKAGE_WEBSOCKETPP
	select BR2_PACKAGE_ZLIB
	help
	  A peer-to-peer file sharing client with a responsive web user 
	  interface for frequent sharing of files and directories within groups of people.

	  https://airdcpp-web.github.io
```
